## rk_secure-disk-encryption/secure-boot-config/fit_kernel.its
```
/dts-v1/;
/ {
    description = "U-Boot FIT source file for arm";

    images {
        fdt {
            data = /incbin/("@KERNEL_DTB@");
            type = "flat_dt";
            arch = "arm64";
            compression = "none";
            load = <0x08300000>;

            hash {
                algo = "sha256";
            };
        };

        kernel {
            data = /incbin/("@KERNEL_IMG@");
            type = "kernel";
            arch = "arm64";
            os = "linux";
            compression = "none";
            entry = <0x00400000>;
            load = <0x00400000>;

            hash {
                algo = "sha256";
            };
        };

		ramdisk {
			data = /incbin/("@RAMDISK_IMG@");
			type = "ramdisk";
			arch = "arm64";
			os = "linux";
			compression = "none";
			load = <0x0a200000>;

			hash {
				algo = "sha256";
			};
		};

        resource {
            data = /incbin/("@RESOURCE_IMG@");
            type = "multi";
            arch = "arm64";
            compression = "none";

            hash {
                algo = "sha256";
            };
        };
    };

    configurations {
        default = "conf";

        conf {
            rollback-index = <0x00>;
            fdt = "fdt";
            kernel = "kernel";
            ramdisk = "ramdisk";
            multi = "resource";
            description = "Rockchip RK3588 FIT Image";

            signature {
                algo = "sha256,rsa2048";
                padding = "pss";
                key-name-hint = "dev";
                sign-images = "fdt", "kernel", "ramdisk", "multi";
            };
        };
    };
};
```
